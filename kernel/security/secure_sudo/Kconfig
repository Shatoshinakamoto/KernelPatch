## kernel/security/secure_sudo/Kconfig
```kconfig
# SPDX-License-Identifier: GPL-2.0 OR Apache-2.0
# SPDX-FileCopyrightText: 2026 Johnathan Edward Brown
config SECURITY_SECURE_SUDO
	bool "Secure Sudo privilege-escalation hardening"
	depends on SECURITY
	select SECURITY_NETWORK
	select SECURITY_PATH
	select CRYPTO_LIB_SHA256
	default n
	help
	  secure_sudo is a built-in Linux Security Module that restricts
	  privileged operations to sudo users and hardens the system against
	  privilege escalation and firmware tampering.

	  This option builds the following protection (more are added by later
	  files in this directory):

	    * Block non-sudo users from switching UID/GID (setuid, setgid,
	      setgroups) and from creating unprivileged user namespaces.
	    * A command blacklist: paths that non-sudo users may not execute,
	      loaded by the root-only CLI through securityfs and matched by
	      (device, inode) and canonical path.
	    * Block non-sudo access to firmware/flash interfaces: /dev/mem,
	      /dev/kmem, /dev/port, /dev/mtd*, /dev/mei*, and write opens under
	      /sys/firmware/ (EFI vars / efivarfs).
	    * Block clearing the TPM via the PPI request node (everyone, root
	      included) unless booted with secure_sudo.tpm_maint=1.
	    * RAM-spike detection that drops caches when real memory usage
	      crosses a configurable threshold.
	    * Restrict exec and PROT_EXEC mmap out of /tmp, /var/tmp and
	      /dev/shm for non-sudo users (with a securityfs allowlist).
	    * A network HOST mode that denies raw/AF_PACKET sockets so packet
	      sniffing fails even with libpcap installed.
	    * A one-way config lock: once set, all knobs refuse writes until
	      the next reboot.
	    * A security event log: the kernel emits events to an in-memory
	      ring the userspace daemon drains, dates and rotates.
	    * A NodeJS child-process guard: node/SEA processes may only spawn
	      allowlisted children.
	    * A sudo brute-force cooldown driven by a PAM feed: after N failed
	      auths a UID is blocked from exec'ing sudo/su.
	    * A driver blacklist (anti-BYOVD): modules matching a blacklisted
	      SHA-256 or name are refused at load.
	    * TimeVault lockdown: an exec allowlist (path + optional hash) with
	      package managers always denied and denied attempts counted.
	    * Confine non-sudo users' writes to their home directory plus the
	      normal scratch/device trees and a configured allowlist (opt-in).
	    * A BPF & perf guard: deny bpf(2) and perf_event_open(2) to
	      non-sudo users, and once the config lock latches refuse
	      tracing-class BPF programs (kprobe, tracepoint, fentry, BPF-LSM,
	      freplace) for every user, root included.
	    * SysctlGuard: refuse writes to security-critical sysctls
	      (core_pattern, modprobe, kptr_restrict, ptrace_scope, ...) and
	      binfmt_misc registration for every user, root included.
	    * An optional feed of every secure_sudo event into the kernel
	      audit subsystem (auditd), and an optional extension of the lock
	      to lockdown's confidentiality class.

	  A "sudo user" is root, or a member of the admin GID configured at
	  runtime via /sys/kernel/secure_sudo/admin_gid (the installer sets this
	  to the distro's sudo/wheel GID).

	  Because it registers LSM credential hooks, secure_sudo must be built
	  into the kernel (it cannot be a loadable module) and must be listed in
	  the active LSM set. Add it to CONFIG_LSM, e.g.

	      CONFIG_LSM="landlock,lockdown,yama,...,secure_sudo,bpf"

	  or append secure_sudo to the lsm= kernel command line. If unsure, N.

config SECURITY_SECURE_SUDO_MEASURE_PCR
	int "TPM PCR that secure_sudo measures policy changes into"
	depends on SECURITY_SECURE_SUDO
	range 8 15
	default 13
	help
	  Every accepted policy change (a knob, a list, the lock) is logged
	  in /sys/kernel/security/secure_sudo/policy_log and extended into
	  this PCR, so a remote verifier can replay the log against a TPM
	  quote (docs/ATTESTATION.md). Pick a PCR nothing else on the
	  machine extends: 13 is free unless systemd-stub measures system
	  extensions (UKI with sysext images), in which case use 15 or 12
	  only if they are free there too. The kernel notices and records
	  any extend it did not make. Needs CONFIG_TCG_TPM=y.
```
